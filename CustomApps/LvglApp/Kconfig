## CustomApps/LvglApp/Kconfig
```kconfig
#
# For a description of the syntax of this configuration file,
# see the file kconfig-language.txt in the NuttX tools repository.
#

config CUSTOM_APPS_LVGL_APP
        tristate "MCP LVGL App"
        default n
        ---help---
                Enable the LVGL App

if CUSTOM_APPS_LVGL_APP

config CUSTOM_APPS_LVGL_APP_PROGNAME
        string "Program name"
        default "lvgl_app"
        ---help---
                This is the name of the program that will be used when the NSH ELF
                program is installed.

config CUSTOM_APPS_LVGL_APP_PRIORITY
        int "LVGL App task priority"
        default 100

config CUSTOM_APPS_LVGL_APP_STACKSIZE
        int "LVGL App stack size"
        default DEFAULT_TASK_STACKSIZE


config CUSTOM_APPS_LVGL_APP_GB_APP
        bool "GB App"
        default y

config CUSTOM_APPS_LVGL_APP_XKCD_APP
        bool "XKCD App"
        default y

endif
```

## CustomApps/olm/Kconfig
```kconfig
config OLM
	bool "libolm Matrix cryptography library"
	default n
	depends on HAVE_CXX && UCLIBCXX
```
