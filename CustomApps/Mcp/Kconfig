## CustomApps/Mcp/Kconfig
```kconfig
#
# For a description of the syntax of this configuration file,
# see the file kconfig-language.txt in the NuttX tools repository.
#

config CUSTOM_APPS_MCP
        tristate "Mcp App"
        default n
        ---help---
                Enable the Mcp App

if CUSTOM_APPS_MCP

config CUSTOM_APPS_MCP_PROGNAME
        string "Program name"
        default "mcp"
        ---help---
                This is the name of the program that will be used when the NSH ELF
                program is installed.

config CUSTOM_APPS_MCP_PRIORITY
        int "Mcp task priority"
        default 100

config CUSTOM_APPS_MCP_STACKSIZE
        int "Mcp stack size"
        default DEFAULT_TASK_STACKSIZE

endif
```

## CustomApps/McpD/Kconfig
```kconfig
#
# For a description of the syntax of this configuration file,
# see the file kconfig-language.txt in the NuttX tools repository.
#

config CUSTOM_APPS_MCPD
        tristate "McpD App"
        default n
        ---help---
                Enable the McpD App

if CUSTOM_APPS_MCPD

config CUSTOM_APPS_MCPD_PROGNAME
        string "Program name"
        default "mcpd"
        ---help---
                This is the name of the program that will be used when the NSH ELF
                program is installed.

config CUSTOM_APPS_MCPD_PRIORITY
        int "McpD task priority"
        default 100

config CUSTOM_APPS_MCPD_STACKSIZE
        int "McpD stack size"
        default DEFAULT_TASK_STACKSIZE

endif
```

## CustomApps/Testing/Kconfig
```kconfig
#
# For a description of the syntax of this configuration file,
# see the file kconfig-language.txt in the NuttX tools repository.
#

config CUSTOM_APPS_TESTING
        tristate "Testing App"
        default n
        ---help---
                Enable the Testing App

if CUSTOM_APPS_TESTING

config CUSTOM_APPS_TESTING_PROGNAME
        string "Program name"
        default "testing"
        ---help---
                This is the name of the program that will be used when the NSH ELF
                program is installed.

config CUSTOM_APPS_TESTING_PRIORITY
        int "Testing task priority"
        default 100

config CUSTOM_APPS_TESTING_STACKSIZE
        int "Testing stack size"
        default DEFAULT_TASK_STACKSIZE

endif
```

## examples/my_lvgl_app/Kconfig
```kconfig
#
# For a description of the syntax of this configuration file,
# see the file kconfig-language.txt in the NuttX tools repository.
#

menuconfig EXAMPLES_MY_LVGL_APP
	tristate "My LVGL App"
	default n
	depends on GRAPHICS_LVGL
	---help---
		Enable my custom LVGL app

if EXAMPLES_MY_LVGL_APP

config EXAMPLES_MY_LVGL_APP_PRIORITY
	int "my_lvgl_app task priority"
	default 100

config EXAMPLES_MY_LVGL_APP_STACKSIZE
	int "my_lvgl_app stack size"
	default 16384

endif # EXAMPLES_MY_LVGL_APP
```
